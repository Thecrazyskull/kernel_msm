## drivers/input/misc/bosh/BMG160/Kconfig
```kconfig
#
# Makefile for Bosch sensors driver.
#
config SENSORS_BMG
	tristate "Bosch Gyroscope Sensor Driver"
	default n
	depends on I2C
	help
	 If you say yes here, you get support for Bosch Sensortec's
	 gyroscope sensor drivers of BMG160/BMI055/BMI058 e.t.c.

config SENSORS_BMG_FIFO
	tristate "Bosch Gyroscope FIFO Support"
	default n
	depends on SENSORS_BMG
	help
	 If you say yes here, you get support for Gyroscope sensor FIFO operations.

config SENSORS_BMI058
	tristate "BMI058 Sensor Support"
	default n
	depends on (SENSORS_BMG || SENSORS_BMA2X2)
	help
	 If you say yes here, you get support for Bosch Sensortec's
	 sensor driver of BMI058.
```

## drivers/input/misc/bosh/BMM050/Kconfig
```kconfig
#
# Makefile for Bosch sensors driver.
#
config SENSORS_BMM050
	tristate "BMM050 Magnetic Sensor Driver"
	default n
	depends on I2C
	help
	 If you say yes here, you get support for Bosch Sensortec's
	 sensor BMM050 Magnetic Sensor
```

## drivers/input/misc/bosh/Kconfig
```kconfig
source "drivers/input/misc/bosh/BMA2X2/Kconfig"
source "drivers/input/misc/bosh/BMG160/Kconfig"
source "drivers/input/misc/bosh/BMM050/Kconfig"
```
